## components/esp32_firebase_utils/Kconfig.projbuild
```kconfig
menu "Firebase Utils Configuration"

    config USE_CONFIG_FOR_FIREBASE_REFRESH_TOKEN
        bool "Use Config for Firebase Auth Secrete"
        default n
        help
            If you want to use the config to store refresh token, please enable this option.            

        config FIREBASE_REFRESH_TOKEN
            string "Refresh Token"
            default ""
            depends on USE_CONFIG_FOR_FIREBASE_REFRESH_TOKEN
            help
                Optional: Refresh token is used to get the access token for the device. 
                If set this option, you can use NULL to replace the `refresh_token` parameter in the firebase_get_access_token_from_refresh_token function.
                The token is used to authenticate the device with the Firebase sevice, such as Firestore, etc.
                For more info, see: https://github.com/wayinone/esp32-firebase-utils/blob/main/gcp_auth/README.md

                The refresh token should add a JWT subject with a unique string, e.g. the device ID. This is useful to identify the device in the Firebase database.

        config FIREBASE_REFRESH_TOKEN_JWT_SUBJECT
            string "Refresh Token JWT Subject (Optional)"
            default ""
            depends on USE_CONFIG_FOR_FIREBASE_REFRESH_TOKEN
            help 
                Optional: This is not used in this component. However, this should be used in projects that include this component. Use this to set your firestore path provides developer a 
                convinent way to set a Firebase Security Rules. e.g. `request.auth.uid == <the JWT subject stored here>`
    
    config FIREBASE_PROJECT_ID
        string "Project ID"
        default ""
        help
            The project ID (or say, the project name) is used to identify the Firebase project. The project ID can be found in the Firebase project settings.

    config FIREBASE_API_KEY
        string "API Key"
        default ""
        help
            The API key is used to authenticate the device with the Firebase service. The API key is used to authenticate the device with the Firebase service, such as Firestore, etc.
            The API key can be found in the Firebase project settings. Note that the API key doesn't need to be kept secret, as it is always revealed when making requests to the Firebase service.
    
    config FIRESTORE_DB_ROOT
        string "Root Path that Contains the First Collection"
        default "databases/(default)/documents"
        help
            The Firestore database root contains the top-level collection in the Firestore database.
endmenu
```

## components/firebase_utils/Kconfig.projbuild
```kconfig
menu "Firebase Utils Configuration"

    config FIREBASE_REFRESH_TOKEN
        string "Refresh Token"
        default ""
        help
            Refresh token is used to get the access token for the device. The token is used to authenticate the device with the Firebase sevice, such as Firestore, etc.
            To get the refresh token, start by creating a service account under the GCP project (that is linked to the Firebase project). The service account should have these roles 
            `Service Account OpenID Connect Identity Token Creator` and `Service Account Token Creator`. The create a JSON private key for the service account and use that to create a `custom token`, and from that custom token, get the refresh token.
            Note that a good practice is to have different private keys (and hence different refresh tokens) for different devices.

            The refresh token can add JWT subject with the device ID as the subject. This is useful to identify the device in the Firebase database.
    
    config FIREBASE_PROJECT_ID
        string "Project ID"
        default ""
        help
            The project ID is used to identify the Firebase project. The project ID can be found in the Firebase project settings.

    config FIREBASE_API_KEY
        string "API Key"
        default ""
        help
            The API key is used to authenticate the device with the Firebase service. The API key is used to authenticate the device with the Firebase service, such as Firestore, etc.
            The API key can be found in the Firebase project settings. Note that the API key doesn't need to be kept secret, as it is always revealed when making requests to the Firebase service.
    
    config FIRESTORE_DB_ROOT
        string "Root Path that Contains the First Collection"
        default "databases/(default)/documents"
        help
            The Firestore database root contains the top-level collection in the Firestore database.
endmenu
```

## sdkconfig.defaults
```kconfig
CONFIG_ESP_TLS_INSECURE=y
CONFIG_ESP_TLS_SKIP_SERVER_CERT_VERIFY=y

CONFIG_SPIRAM=y
CONFIG_MBEDTLS_EXTERNAL_MEM_ALLOC=y
# CONFIG_MBEDTLS_HAVE_TIME_DATE is not set
```
